## conf/layer.conf
```bitbake
BBPATH =. "${LAYERDIR}:"

BBFILES += "${LAYERDIR}/recipes-*/*/*.bb \
            ${LAYERDIR}/recipes-*/*/*.bbappend"

BBFILES_DYNAMIC += " \
    openembedded-layer:${LAYERDIR}/dynamic-layers/openembedded-layer/*/*/*.bb \
    openembedded-layer:${LAYERDIR}/dynamic-layers/openembedded-layer/*/*/*.bbappend \
    \
"

BBFILE_COLLECTIONS += "meta-starfive"
BBFILE_PATTERN_meta-starfive = "^${LAYERDIR}/"
BBFILE_PRIORITY_meta-starfive = "8"
LAYERVERSION_meta-starfive = "1"

LAYERSERIES_COMPAT_meta-starfive = "walnascar"

PACKAGE_CLASSES = "package_ipk"
LICENSE_FLAGS_ACCEPTED += "commercial_ffmpeg \
			   commercial_gstreamer1.0-plugins-ugly \
			   commercial_mpeg2dec \
			   commercial_gstreamer1.0-libav \ 
			   commercial_gstreamer1.0-omx \
			   "
```

## conf/machine/starfive-dubhe.conf
```bitbake
#@TYPE: Machine
#@NAME: starfive-dubhe
#@SOC: Dubhe default
#@DESCRIPTION: Machine configuration for the Dubhe default config

LLVMVERSION = "20.1.7"
CLANGSDK = "1"
EXTRA_IMAGEDEPENDS:append = " llvm file-native rpm-native popt-native openocd-native u-boot-starfive"
EXTRA_IMAGE_FEATURES:append = " dbg-pkgs tools-profile"

PACKAGE_DEBUG_SPLIT_STYLE = 'debug-file-directory'

#require conf/machine/include/qemu.inc
# qemuboot options
EXTRA_IMAGEDEPENDS:append = " qemu-helper-native:do_addto_recipe_sysroot"
IMAGE_CLASSES += " qemuboot "
QB_MACHINE = "-machine virt"
QB_DEFAULT_KERNEL = "Image"
QB_DEFAULT_BIOS = "fw_dynamic.bin"
QB_CPU = "-cpu rv64"
QB_DEFAULT_FSTYPE = "ext4"
SERIAL_CONSOLES = "115200;ttyS0"
QB_SYSTEM_NAME = "qemu-system-riscv64"
QB_MEM = "-m 2048"
QB_OPT_APPEND = "-smp 8"
QB_ROOTFS_OPT = "-drive file=@ROOTFS@,format=raw,id=mmc0,if=none -device virtio-blk-device,drive=mmc0"

require conf/machine/include/riscv/tune-riscv.inc

MACHINE_FEATURES = "screen keyboard ext2 ext3 serial"

KERNEL_DEVICETREE ?= " \
    starfive/dubhe70_fpga.dtb \
    starfive/dubhe70a_fpga.dtbo \
    starfive/dubhe70s500_fpga.dtbo \
    starfive/dubhe70s700_fpga.dtbo \
    starfive/dubhe80_fpga.dtb \
    starfive/dubhe83_fpga.dtb \
    starfive/dubhe83a_fpga.dtbo \
    starfive/dubhe83s700_fpga.dtbo \
    starfive/dubhe90_fpga.dtb \
    starfive/dubhe100_fpga.dtb \
    "
KERNEL_IMAGETYPE = "Image"

KEEPUIMAGE = "no"
INITRAMFS_FSTYPES ?= "cpio.gz cpio.lzma"
INITRAMFS_MAXSIZE = "524288"

PREFERRED_PROVIDER_virtual/kernel ?= "linux-starfive-dev"
PREFERRED_VERSION_linux-starfive-dev = "6.18%"
PREFERRED_PROVIDER_virtual/bootloader = "u-boot-starfive"
RISCV_SBI_PLAT = "generic"

QEMU_EXTRAOPTIONS:riscv64 = " -cpu rv64,x-b=true,x-v=true"

GLIBCVERSION = "2.39%"
BINUVERSION = "2.44"
GCCVERSION = "15.1.0"
QEMUVERSION = "10.0.0"
PREFERRED_VERSION_opensbi = "1.6%"
PREFERRED_VERSION_gdb = "16.3"
PREFERRED_VERSION_openocd = "riscv"
PREFERRED_VERSION_openocd-native = "riscv"

PREFERRED_PROVIDER_llvm = "clang"
PREFERRED_PROVIDER_llvm-native = "clang-native"
PREFERRED_PROVIDER_nativesdk-llvm = "nativesdk-clang"
PROVIDES:pn-clang = "llvm"
PROVIDES:pn-clang-native = "llvm-native"
PROVIDES:pn-nativesdk-clang = "nativesdk-llvm"

# Please remove these after upgrading clang
PREFERRED_PROVIDER_libclc-native = "clang-native"
PREFERRED_PROVIDER_nativesdk-libclc = "nativesdk-clang"

#
###IMAGE_FSTYPES += "wic.gz wic.bmap ext4 cpio"

#UBOOT_CONFIG = "defconfig"

UBOOT_MACHINE = "starfive_dubhe_fpga_defconfig"
#UBOOT_MACHINE = "qemu-riscv64_spl_defconfig"

UBOOT_DTB_BINARY = "dubhe_fpga.dtb"

SPL_BINARY = "spl/u-boot-spl.bin"
SPL_NORMAL_BINARY = "u-boot-spl.bin.normal.out"

## Do not update fstab file when using wic images
###WIC_CREATE_EXTRA_ARGS ?= "--no-fstab-update"


## wic default support
WKS_FILE_DEPENDS ?= " \
    opensbi \
    bmaptool-native \
"


###IMAGE_BOOT_FILES ?= " \
###    fw_payload.bin \
###    ${KERNEL_IMAGETYPE} \
###    ${RISCV_SBI_FDT}  \
###    boot.scr.uimg \
###"
WKS_FILE ?= "starfive-dubhe.wks"
```

## conf/machine/starfive-jh8100.conf
```bitbake
#@TYPE: Machine
#@NAME: starfive-jh8100
#@SOC: JH8100
#@DESCRIPTION: Machine configuration for the JH8100 default config

require conf/machine/include/riscv/tune-riscv.inc

EXTRA_IMAGEDEPENDS:append = " qemu-helper-native:do_addto_recipe_sysroot"
IMAGE_CLASSES += " qemuboot "
QB_MACHINE = "-machine virt"
QB_DEFAULT_KERNEL = "Image-starfive-jh8100.bin"
QB_CPU = "-cpu rv64"
QB_MEM = "-m 8G"
QB_DEFAULT_FSTYPE = "ext4"
SERIAL_CONSOLES = "115200;ttyS0"
QB_SYSTEM_NAME = "qemu-system-riscv64"
QB_ROOTFS_OPT = "-drive file=@ROOTFS@,format=raw,id=hd0 -device virtio-blk-device,drive=hd0"

MACHINE_FEATURES = "screen keyboard ext2 ext3 serial"

SERIAL_CONSOLE = "115200 ttyS0"

PREFERRED_PROVIDER_virtual/kernel = "linux-starfive-dev"
PREFERRED_PROVIDER_virtual/bootloader = "u-boot-starfive"

LLVMVERSION = "16.0.5"
GLIBCVERSION = "2.36"
BINUVERSION = "2.39"
GCCVERSION = "12.2.0"
QEMUVERSION = "7.2.0"
PREFERRED_VERSION_openocd = "riscv"
PREFERRED_VERSION_openocd-native = "riscv"
PREFERRED_VERSION_opensbi ?= "1.2"
PREFERRED_VERSION_xserver-xorg = "1.20.13"
PREFERRED_VERSION_mbedtls = "3.4.0"
PREFERRED_PROVIDER_dhcp-relay = "dhcp"
PREFERRED_PROVIDER_nodejs = "18.0.0"

RISCV_SBI_PLAT = "generic"
#RISCV_SBI_PAYLOAD = "u-boot.bin"
#RISCV_SBI_FDT = "jh8100-fpga.dtb"

IMAGE_FSTYPES += " ext4 wic.gz wic.bmap cpio cpio.gz"

KERNEL_DEVICETREE ?= "starfive/jh8100-fpga.dtb"
KERNEL_IMAGETYPE = "Image"

FIT_KERNEL_COMP_ALG = "none"

EXTRA_IMAGEDEPENDS += " u-boot-starfive openocd-native"

UBOOT_ENV ?= "boot"
UBOOT_ENV_SUFFIX = "scr.uimg"

UBOOT_MACHINE = "starfive_jh8100_defconfig"
#UBOOT_MACHINE = "qemu-riscv64_spl_defconfig"
UBOOT_DTB_BINARY = "jh8100-fpga.dtb"

SPL_BINARY = "spl/u-boot-spl.bin"
SPL_NORMAL_BINARY = "u-boot-spl.bin.normal.out"

## Do not update fstab file when using wic images
WIC_CREATE_EXTRA_ARGS ?=  "--no-fstab-update"

WKS_FILE_DEPENDS ?= " \
	opensbi \
	bmap-tools-native \
"
IMAGE_BOOT_FILES ?= " \
        jh8100-fpga.dtb \
	Image \
	uboot.env \
	u-boot.itb \
"
WKS_FILE ?= "starfive-jh8100.wks"
```

## conf/machine/starfive-visionfive2.conf
```bitbake
#@TYPE: Machine
#@NAME: VisionFive 2
#@SOC: JH7110
#@DESCRIPTION: Machine configuration for the VisionFive 2 default config

require conf/machine/include/riscv/tune-riscv.inc

MACHINE_FEATURES = "screen keyboard ext2 ext3 serial"

SERIAL_CONSOLE = "115200 ttyS0"

PREFERRED_PROVIDER_virtual/kernel = "linux-starfive-dev"
PREFERRED_PROVIDER_virtual/bootloader = "u-boot-starfive"

PREFERRED_VERSION_glibc ?= "2.35"
PREFERRED_VERSION_gcc ?= "11.3.0"
PREFERRED_VERSION_binutils ?= "2.38"
PREFERRED_VERSION_opensbi ?= "1.2"

RISCV_SBI_PLAT = "generic"
RISCV_SBI_PAYLOAD = "u-boot.bin"
RISCV_SBI_FDT = "starfive_visionfive2.dtb"

KERNEL_CLASSES = "kernel-fitimage"
KERNEL_DEVICETREE ?= "starfive/jh7110-visionfive-v2.dtb"
KERNEL_IMAGETYPE = "fitImage"
UBOOT_ENTRYPOINT = "0x40200000"
UBOOT_DTB_LOADADDRESS = "0x46000000"
UBOOT_RD_ENTRYPOINT = "0x46100000"
UBOOT_RD_LOADADDRESS = "0x46100000"
UBOOT_DTB = "1"

INITRAMFS_FSTYPES = "cpio.gz"
IMAGE_FSTYPES += "wic.gz wic.bmap ext4"
FIT_KERNEL_COMP_ALG = "none"

EXTRA_IMAGEDEPENDS += "u-boot-starfive"

UBOOT_ENV ?= "boot"
UBOOT_ENV_SUFFIX = "scr.uimg"

UBOOT_MACHINE = "starfive_visionfive2_defconfig"
UBOOT_DTB_BINARY = "starfive_visionfive2.dtb"

SPL_BINARY = "spl/u-boot-spl.bin"
SPL_NORMAL_BINARY = "u-boot-spl.bin.normal.out"

## Do not update fstab file when using wic images
WIC_CREATE_EXTRA_ARGS ?=  "--no-fstab-update"

WKS_FILE_DEPENDS ?= " \
	opensbi \
"

IMAGE_BOOT_FILES ?= " \
	vf2_uEnv.txt \
	vf2_nvme_uEnv.txt \
	starfiveu.fit \
	fitImage-linux.bin-starfive-visionfive2 \
	initramfs.img \
	jh7110-visionfive-v2-starfive-visionfive2.dtb \
"
WKS_FILE ?= "starfive-visionfive2.wks"
```

## recipes-bsp/u-boot/files/visionfive2-fit-image.its
```
/dts-v1/;

/ {
        description = "Kernel fitImage for visionfive2";
        #address-cells = <1>;

        images {
                kernel-1 {
                        description = "Linux kernel";
                        data = /incbin/("./tmp/fitImage-linux.bin-starfive-visionfive2");
                        type = "kernel";
                        arch = "riscv";
                        os = "linux";
                        compression = "none";
                        load = <0x40200000>;
                        entry = <0x40200000>;
                        hash-1 {
                                algo = "sha256";
                        };
                };
                fdt-starfive_jh7110-visionfive-v2.dtb {
                        description = "Flattened Device Tree blob";
                        data = /incbin/("./tmp/jh7110-visionfive-v2-starfive-visionfive2.dtb");
                        type = "flat_dt";
                        arch = "riscv";
                        compression = "none";
                        load = <0x46000000>;
                        hash-1 {
                                algo = "sha256";
                        };
                };
                ramdisk-1 {
                        description = "core-image-minimal-initramfs";
                        data = /incbin/("initramfs.img");
                        type = "ramdisk";
                        arch = "riscv";
                        os = "linux";
                        compression = "none";
                        load = <0x46100000>;
                        entry = <0x46100000>;
                        hash-1 {
                                algo = "sha256";
                        };
                };
        };

        configurations {
                default = "conf-starfive_jh7110-visionfive-v2.dtb";
                conf-starfive_jh7110-visionfive-v2.dtb {
                        description = "1 Linux kernel, FDT blob, ramdisk";
                        kernel = "kernel-1";
                        fdt = "fdt-starfive_jh7110-visionfive-v2.dtb";
                        ramdisk = "ramdisk-1";


                        hash-1 {
                                algo = "sha256";
                        };
                };
        };
};
```

## wic/starfive-dubhe.wks
```
#short-description: Create SD card image for Starfive Duhbe
# long-description: Creates a partitioned SD card image for Starfive Dubhe.

#boot partition (empty)
part /boot --ondisk mmcblk0 --fstype=vfat --label boot --active --align 1024 --size=17M --use-uuid

#root partition 
part / --source rootfs --ondisk mmcblk0 --fstype=ext4 --label root --align 1024 --use-uuid

bootloader --append "rootwait console=ttyS0,115200"
```

## wic/starfive-jh8100.wks
```
#short-description: Create SD card image for Starfive Duhbe
# long-description: Creates a partitioned SD card image for Starfive Dubhe.

#boot partition
part /boot --source bootimg-partition --ondisk mmcblk0 --fstype=vfat --label boot --active --align 1024 --size=200M --use-uuid

#root partition
part / --source rootfs --ondisk mmcblk0 --fstype=ext4 --label root --align 1024 --size=2G --use-uuid

bootloader --append "rootwait console=ttyS0,115200"
```

## wic/starfive-visionfive2.wks
```
#short-description: Create SD card image for Starfive VisionFive2
# long-description: Creates a partitioned SD card image for Starfive VisionFive2.

part spl --source rawcopy  --sourceparams="file=u-boot-spl.bin.normal.out" --part-name spl --offset 2M --size 2M --part-type 2E54B353-1271-4842-806F-E436D6AF6985

part uboot --source rawcopy --sourceparams="file=visionfive2_fw_payload.img" --part-name uboot --offset 4M --size 4M --part-type 5B193300-FC78-40CD-8002-E86C45580B47

part /boot --source bootimg-partition --fstype=vfat --label boot --use-uuid --part-name boot --part-type EBD0A0A2-B9E5-4433-87C0-68B6B72699C7 --align 4096 --size 292M

part /root --source rootfs --fstype=ext4 --part-name root --part-type 0FC63DAF-8483-4772-8E79-3D69D8477DE4 --active --label root --align 4096

bootloader  --ptable gpt
```
